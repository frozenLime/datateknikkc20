//Define libraries used
#include <SPI.h>
#include <MFRC522.h>
#include <WiFi.h>
#include <esp_now.h>
#include <Wire.h>
#include <Adafruit_GFX.h>
#include <Adafruit_SSD1306.h>
#include <Servo.h>

//Define communication ports for RFID
#define SS_PIN 5
#define RST_PIN 4

//Define display resolution
#define SCREEN_WIDTH 128
#define SCREEN_HEIGHT 64

//Defining the port used by the servo
#define BUZZER 33

//Setting the OLED display
Adafruit_SSD1306 display(SCREEN_WIDTH, SCREEN_HEIGHT, &Wire, -1);

//Setting the servo
Servo door;

//Arrays for locked and unlocked graphics
const uint8_t locked[] = {
  0x00, 0x00, 0x00, 0x00, 0x00, 0x00, 0x00, 0x00, 0x1f, 0xe0, 0x00, 0x00, 0x00,
  0x00, 0xe0, 0x38, 0x00, 0x00, 0x00, 0x01, 0x80, 0x0c, 0x00, 0x00, 0x00, 0x02, 
  0x1f, 0xc2, 0x00, 0x00, 0x00, 0x04, 0x70, 0x31, 0x00, 0x00, 0x00, 0x08, 0xc0, 
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  0x00, 0x00, 0x00, 0x00, 0x00, 0x00
  };

const uint8_t unlocked[] = {
  0x00, 0x00, 0x00, 0x00, 0x00, 0x00, 0x00, 0x00, 0x00, 0x00, 0x00, 0x00, 0x00, 
  0x00, 0x00, 0x07, 0xfc, 0x00, 0x00, 0x00, 0x00, 0x1c, 0x07, 0x00, 0x00, 0x00, 
  0x00, 0x20, 0x41, 0x80, 0x00, 0x00, 0x00, 0x47, 0xf8, 0x40, 0x00, 0x00, 0x00, 
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  0x00, 0x00, 0x00, 0x00, 0x00, 0x00
  };

//Setting up RFID reader
MFRC522 rfid(SS_PIN, RST_PIN);
MFRC522::MIFARE_Key key; 

//Reciever MAC address
uint8_t broadcastAddress[] = {0xE8, 0x31, 0xCD, 0xE6, 0x39, 0x94};

//ID of this ESP
uint8_t id = 2;

//Setting a start position for the servo
int servoSpos = 90;

//Setting a struct for the ESPnow messages
typedef struct struct_message{
    uint8_t id;
    String cardUID;
    uint8_t access;
    bool sensorMotion;
    float sensorTemperature; 
    float sensorHumidity;
    float sensorLightLevel;
}

//Structiong messages
struct_message;
struct_message transferData;
struct_message incoming;

//Setting ESPnow peer info as peerInfo
esp_now_peer_info_t peerInfo;

// When data is recieved from masternode check the access boolean (int)
void OnDataRecv(const uint8_t * mac, const uint8_t *incomingData, int len) {
  memcpy(&incoming, incomingData, sizeof(incoming));
  if(incoming.access==1){
    accessGranted();
  }
  if(incoming.access==0){
    noAccess();
  }    
}

//Function for reading the processing card information
void cardRead(){
    //If NO new RFID card is present
    if (!rfid.PICC_IsNewCardPresent())
    return;
    //If new card is NOT read
    if (!rfid.PICC_ReadCardSerial())
    return;
    //Concat every char in the RFID card UID
    for (int i = 0; i < rfid.uid.size; i++){
      transferData.cardUID.concat(String(rfid.uid.uidByte[i], HEX));
    }
    //Transform UID to uppercase
    transferData.cardUID.toUpperCase();
    //Pause the RFID reader
    rfid.PICC_HaltA();
    //Call the "transmit" function
    transmit();
}
//Function to transmit the ESPid and RFID UID, deletes the "buffer" after sending
void transmit(){
  transferData.id = id;
  transferData.cardUID;
  esp_err_t result = esp_now_send(broadcastAddress, (uint8_t *) &transferData, sizeof(transferData));
  transferData.cardUID = ("");
}

//Function for the IDLE display and welcoming message, printing text and graphics to the OLED display, also stopping the buzzer
void updateDisplayIdle(){
    ledcWriteTone(3, 0);
    display.clearDisplay();
    display.setCursor(0, 50);
    display.setTextWrap(0);
    display.setCursor(25, 50);
    display.println("Read ID-card!");
    display.drawBitmap(40, 5, locked, 45, 40, 1);
    display.display();   
}

//Function for a NO ACCESS graphics and text to be printed to the OLED display, setting a buzzer tone to indicate "no access"
void noAccess() {
    display.clearDisplay();
    display.setCursor(0, 50);
    display.setTextWrap(0);
    display.setCursor(34, 50);
    display.println("No access!");
    display.drawBitmap(40, 5, locked, 45, 40, 1);
    display.display();
    ledcWriteTone(3, 500);
    delay(4000);
    updateDisplayIdle();
  }

//Function for an ACCESS GRANTED graphics and text to be printed to the OLED display, also opening the gate (servo), again closing it after 4 seconds
void accessGranted() {
    display.clearDisplay();
    display.setCursor(0, 50);
    display.setTextWrap(0);
    display.setCursor(19, 50);
    display.println("Access granted!");
    display.drawBitmap(45, 5, unlocked, 45, 40, 1);
    display.display();
    door.write(180);
    delay(4000);
    door.write(90); 
    
    updateDisplayIdle();
}

//Setup the ESP
void setup() { 
  //Begin SPI comm.
  SPI.begin();
  //Initialising the RFID reader
  rfid.PCD_Init();

  //Set WiFi mode to stationary
  WiFi.mode(WIFI_STA);

  //Attaching servo to pin 32
  door.attach(32);
  
  //Setting the servo to the start position
  door.write(servoSpos);

  //Setting the channel and mode for the buzzer
  ledcSetup(3, 8000, 12);

  //Setting the buzzer pin to the channel
  ledcAttachPin(BUZZER, 3);

  //Init the display
  display.begin(SSD1306_SWITCHCAPVCC, 0x3C);
  delay(2000);
  display.setTextColor(WHITE);
  
  //Set IDLE screen
  display.clearDisplay();
  display.setCursor(0, 50);
  display.setTextWrap(0);
  display.setCursor(25, 50);
  display.println("Read ID-card!");
  display.drawBitmap(40, 5, locked, 45, 40, 1);
  display.display();

  // Init ESP-NOW
  if (esp_now_init() != ESP_OK) {
    return;
  }
  
  //Reading the reciever info
  memcpy(peerInfo.peer_addr, broadcastAddress, 6);
  peerInfo.channel = 0;  
  peerInfo.encrypt = false;
  
  //Connecting to reciever    
  if (esp_now_add_peer(&peerInfo) != ESP_OK){
    return;
  }
  //Starting the reciveing function
  esp_now_register_recv_cb(OnDataRecv);
}

//Main loop running the card checking function
void loop() {
  cardRead();
}
